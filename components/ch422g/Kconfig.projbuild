## components/ch422g/Kconfig.projbuild
```kconfig
menu "CH422G IO expander"

config CH422G_I2C_ADDRESS
    hex "CH422G I2C 7-bit address"
    range 0x08 0x77
    default 0x24
    help
        7-bit address of the CH422G-compatible IO expander (CH32V003 on the
        Waveshare board). The address is read at runtime instead of being
        hardcoded.

endmenu
```

## main/Kconfig
```kconfig
menu "Application"

    config APP_USE_SQLITE3
        bool "Enable SQLite3 database storage"
        default n
        help
            Build the SQLite3-backed database manager. When disabled, the
            database manager logs a warning and returns an error for database
            operations. Enable this only when a sqlite3 component is provided
            via the ESP-IDF component registry or a local component.

endmenu
```

## sdkconfig.defaults
```kconfig
# Default SDK configuration for the ESP32 Reptile Manager skeleton.
# In a real project you would generate this using `idf.py menuconfig`.
# These options enable external SPIRAM and set log verbosity to
# informational.  Refer to the official ESP‑IDF documentation for
# further details.

CONFIG_ESP32S3_SPIRAM_SUPPORT=y
CONFIG_SPIRAM_SPEED_80M=y
CONFIG_PARTITION_TABLE_CUSTOM=y
CONFIG_PARTITION_TABLE_CUSTOM_FILENAME="partitions.csv"
CONFIG_LOG_DEFAULT_LEVEL_INFO=y
```

## sdkconfig.defaults.no_psram
```kconfig
# Default SDK configuration for boards without external PSRAM.
# Use this file when your ESP32-S3 module does not include PSRAM or when
# you want to boot without external memory.
# CONFIG_ESP32S3_SPIRAM_SUPPORT is not set
# CONFIG_SPIRAM_SPEED_80M is not set
CONFIG_ESPTOOLPY_FLASHSIZE_32MB=y
CONFIG_ESPTOOLPY_FLASHSIZE="32MB"
CONFIG_PARTITION_TABLE_CUSTOM=y
CONFIG_PARTITION_TABLE_CUSTOM_FILENAME="partitions.csv"
CONFIG_LOG_DEFAULT_LEVEL_INFO=y
```
